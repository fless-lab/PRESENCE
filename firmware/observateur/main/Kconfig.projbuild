## firmware/observateur/main/Kconfig.projbuild
```kconfig
menu "PRESENCE"
    config PRESENCE_SALLE
        int "Identifiant numérique de la salle"
        range 0 65535
        default 204
    config PRESENCE_NOM_OBSERVATEUR
        string "Nom de l'observateur"
        default "204-A"
    config PRESENCE_WIFI_SSID
        string "Réseau Wi-Fi"
        default "presence-proto"
    config PRESENCE_WIFI_MDP
        string "Mot de passe Wi-Fi"
        default ""
    config PRESENCE_URL_SERVEUR
        string "Adresse du serveur (sans barre oblique finale)"
        default "http://192.168.1.10:8000"
    config PRESENCE_MODE_TEST
        bool "Mode test (expérience 01)"
        default n
        help
            Ignore la configuration du serveur : annonce une séance 1 active dans
            la salle PRESENCE_SALLE et journalise chaque trame ATTEST reçue sans
            vérifier la signature. Aucun témoignage n'est produit.
    config PRESENCE_GPIO_LED
        int "Broche du voyant d'état (-1 pour aucun)"
        range -1 48
        default 2
endmenu
```

## firmware/porte/main/Kconfig.projbuild
```kconfig
menu "PRESENCE"
    config PRESENCE_SALLE
        int "Identifiant numérique de la salle"
        default 204
    config PRESENCE_NOM_OBSERVATEUR
        string "Nom du compteur"
        default "204-P"
    config PRESENCE_WIFI_SSID
        string "Réseau Wi-Fi"
        default "presence-proto"
    config PRESENCE_WIFI_MDP
        string "Mot de passe Wi-Fi"
        default ""
    config PRESENCE_URL_SERVEUR
        string "Adresse du serveur"
        default "http://192.168.1.10:8000"
endmenu
```

## firmware/porte/sdkconfig.defaults
```kconfig
CONFIG_MBEDTLS_ECP_C=y
CONFIG_MBEDTLS_ECDSA_C=y
CONFIG_MBEDTLS_ECP_DP_SECP256R1_ENABLED=y
```
